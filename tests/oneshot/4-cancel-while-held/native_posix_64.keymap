/* Pressing a cancel key while the one-shot is held (unused) cancels it, so it is not queued on release. */
#include "../behavior_keymap.dtsi"

&kscan {
    events = <
        ZMK_MOCK_PRESS(0,1,10)    /* hold layer */
        ZMK_MOCK_PRESS(0,0,10)    /* hold one-shot Shift */
        ZMK_MOCK_PRESS(1,1,10)    /* press the other layer key: cancels Shift */
        ZMK_MOCK_RELEASE(1,1,10)
        ZMK_MOCK_RELEASE(0,0,10)  /* release Shift: nothing queued */
        ZMK_MOCK_RELEASE(0,1,10)
        ZMK_MOCK_PRESS(0,0,10)    /* tap A: plain */
        ZMK_MOCK_RELEASE(0,0,10)
    >;
};

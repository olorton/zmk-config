/* Held one-shot used while held acts as a normal modifier and is released with the key, not queued. */
#include "../behavior_keymap.dtsi"

&kscan {
    events = <
        ZMK_MOCK_PRESS(0,1,10)    /* hold layer */
        ZMK_MOCK_PRESS(0,0,10)    /* hold one-shot Shift */
        ZMK_MOCK_PRESS(1,0,10)    /* tap X: shifted */
        ZMK_MOCK_RELEASE(1,0,10)
        ZMK_MOCK_PRESS(1,0,10)    /* tap X: shifted */
        ZMK_MOCK_RELEASE(1,0,10)
        ZMK_MOCK_RELEASE(0,0,10)  /* release Shift: released, not queued */
        ZMK_MOCK_PRESS(1,0,10)    /* tap X: plain */
        ZMK_MOCK_RELEASE(1,0,10)
        ZMK_MOCK_RELEASE(0,1,10)
    >;
};

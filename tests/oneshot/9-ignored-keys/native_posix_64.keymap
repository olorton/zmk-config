/* Modifier keys (here a plain Shift key) don't use up a queued one-shot. */
#include "../behavior_keymap.dtsi"

&kscan {
    events = <
        ZMK_MOCK_PRESS(0,1,10)    /* hold layer */
        ZMK_MOCK_PRESS(0,0,10)    /* tap one-shot Shift */
        ZMK_MOCK_RELEASE(0,0,10)
        ZMK_MOCK_RELEASE(0,1,10)  /* release layer */
        ZMK_MOCK_PRESS(1,0,10)    /* tap plain Shift: ignored */
        ZMK_MOCK_RELEASE(1,0,10)
        ZMK_MOCK_PRESS(0,0,10)    /* tap A: still shifted by the one-shot */
        ZMK_MOCK_RELEASE(0,0,10)
    >;
};
